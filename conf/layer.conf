## conf/layer.conf
```bitbake
# We have a conf and classes directory, add to BBPATH
BBPATH:prepend = "${LAYERDIR}:"

# We have recipes-* directories, add to BBFILES
BBFILES += "\
  ${LAYERDIR}/recipes-*/*/*.bb \
  ${LAYERDIR}/recipes-*/*/*.bbappend \
  ${LAYERDIR}/meta-${DISTRO}/recipes-*/*/*.bb \
  ${LAYERDIR}/meta-${DISTRO}/recipes-*/*/*.bbappend \
"

BBFILE_COLLECTIONS += "de.sigma-chemnitz.core"
BBFILE_PATTERN_de.sigma-chemnitz.core = "^${LAYERDIR}/"
BBFILE_PRIORITY_de.sigma-chemnitz.core = "30"
LAYERSERIES_COMPAT_de.sigma-chemnitz.core = "honister"

LAYERDIR_de.sigma-chemnitz.core := "${LAYERDIR}"

ELITO_PUBLIC_GIT_REPO ?= "git+https://github.com/sigma-embedded"

## TODO: move this to somewhere else
BUILDVARS_SCRIPT_DIR = "${LAYERDIR_de.sigma-chemnitz.core}/scripts/buildvars"

INHERIT += "elito-uridecode"

## legacy variable
BASEPATH_de.sigma-chemnitz.core = "${LAYERDIR_de.sigma-chemnitz.core}"
```
